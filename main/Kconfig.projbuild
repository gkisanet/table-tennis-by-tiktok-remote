## main/Kconfig.projbuild
```kconfig
menu "Example Configuration"

    config EXAMPLE_SSP_ENABLED
        bool "Enable Secure Simple Pairing (SSP)"
        default y
        depends on BT_CLASSIC_ENABLED
        help
            This option enables Secure Simple Pairing for Bluetooth Classic connections.
            When enabled, the device will use "Just Works" mode which doesn't require
            a PIN code for pairing. This is typically better for HID devices.

endmenu
```

## sdkconfig.defaults
```kconfig
CONFIG_BT_ENABLED=y
CONFIG_BT_BLUEDROID_ENABLED=y
CONFIG_BT_BLE_ENABLED=y
CONFIG_BT_BLE_42_FEATURES_SUPPORTED=y
CONFIG_BT_HID_HOST_ENABLED=y

# GATTC settings - CRITICAL: increase notification limit for JX-05 (has 8 reports)
CONFIG_BT_GATTC_ENABLE=y
CONFIG_BT_GATTC_CONNECT_RETRY_COUNT=3
CONFIG_BT_GATTC_NOTIF_REG_MAX=15

# Security settings - no bonding
CONFIG_BT_SMP_ENABLE=y
CONFIG_BT_BLE_SMP_ENABLE=y

# Log level for debugging
CONFIG_LOG_DEFAULT_LEVEL_INFO=y
CONFIG_ESP_HIDH_DEBUG=y
```
